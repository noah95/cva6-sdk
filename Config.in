## Config.in
```kconfig
source "$BR2_EXTERNAL_HERO_PATH/package/Config.in"

source "$BR2_EXTERNAL_HERO_PATH/package/hero-openmp/Config.in"
```

## package/hero-openmp/Config.in
```kconfig
config BR2_PACKAGE_HERO_OPENMP
	bool "LLVM OpenMP offload plugin for HERO accelerators (Snitch/PULP)"
	select BR2_PACKAGE_ELFUTILS
	select BR2_PACKAGE_LIBFFI
```
